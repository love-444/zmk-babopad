## dts/bindings/babopad.yaml
```yaml
# Copyright (c) 2022 The ZMK Contributors
# SPDX-License-Identifier: MIT
description: |
  Input driver for ADC io channel

compatible: "zmk,babopad"

properties:
  sampling-hz:
    type: int
    default: 100
  adc-channels:
    type: array
    default: [0, 5, 7]
    required: true
  pwm-channels:
    type: array
    default: [0, 1, 2]
    required: true
  dpi:
    type: int
    default: 1000
    required: true
  x-invert:
    type: boolean
  y-invert:
    type: boolean
  xy-swap:
    type: boolean
  evt-type:
    type: int
    required: true
  input-code-x:
    type: int
    required: true
  input-code-y:
    type: int
    required: true
```
